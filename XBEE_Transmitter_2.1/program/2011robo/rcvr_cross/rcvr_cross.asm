
;****************** 魔法の言葉(ATmega168p) ******************

.include "m168pdef.inc"

.def	STACK	=	R16
.def	RWREG	=	R17
.def	RDATA	=	R18
.def	LS		=	R26
.def	RS		=	R27
.def	LHRV	=	R28
.def	LVRV	=	R29
.def	RHRV	=	R30
.def	RVRV	=	R31

;.EQU ENAME	=	0
.EQU	STA_C	=	0
.EQU	STA_Z	=	1
.EQU	STA_N	=	2
.EQU	STA_V	=	3
.EQU	STA_S	=	4
.EQU	STA_H	=	5
.EQU	STA_T	=	6
.EQU	STA_I	=	7

;.dseg	data:	.BYTE	10
;.dseg
;	dSDATA:	.BYTE	7

.CSEG
	RJMP	INIT

INIT:
	
	CLI	
	;0:in 1:out
	LDI		RWREG	,0B00111011
	OUT		DDRB	,RWREG
	LDI		RWREG	,0B00001111
	OUT		DDRC	,RWREG
	LDI		RWREG	,0B11101000
	OUT		DDRD	,RWREG
	LDI		RWREG	,0B00000000
	OUT		PORTB	,RWREG
	LDI		RWREG	,0B00000000
	OUT		PORTC	,RWREG
	LDI		RWREG	,0B00000000
	OUT		PORTD	,RWREG
	
;******** USART設定 ********
	LDI		RWREG	,0
	STS		UBRR0H	,RWREG
	LDI 	RWREG	,64
	STS		UBRR0L	,RWREG


	LDI		RWREG	,((1<<UCSZ01)|(1<<UCSZ00))
	STS		UCSR0C	,RWREG

	LDI		RWREG	,((1<<RXEN0)|(1<<TXEN0))
	STS		UCSR0B	,RWREG

;******** A/D設定 ********
;	LDI		RWREG	,0B01100000
;	STS		ADMUX	,RWREG
;	LDI		RWREG	,((1<<ADEN)|(1<<ADIF))
;	STS		ADCSRA	,RWREG
;	LDI		RWREG	,0B00000000
;	STS		ADCSRB	,RWREG

;********タイマ設定********
	;----初期値----
	LDI		RWREG	,0x00
	OUT		TCNT0	,RWREG
	;----PWM初期値----
	LDI		RWREG	,0xff
	OUT		OCR0A	,RWREG
	OUT		OCR0B	,RWREG
	;----0x00:ノーマル 0x02:CTC(比較)----
	;----0x03:PWM
	LDI		RWREG	,0B10100011
	OUT		TCCR0A	,RWREG
	;----プリスケーラ----
	LDI		RWREG	,0x02
	OUT		TCCR0B	,RWREG

	;----初期値----
	LDI		RWREG	,0x00
	STS		TCNT2	,RWREG
	;----PWM初期値----
	LDI		RWREG	,0xff
	STS		OCR2A	,RWREG
	STS		OCR2B	,RWREG
	;----0x00:ノーマル 0x02:CTC(比較)----
	;----0x03:PWM
	LDI		RWREG	,0B10100011
	STS		TCCR2A	,RWREG
	;----プリスケーラ----
	LDI		RWREG	,0x02
	STS		TCCR2B	,RWREG

	;----全割り込み許可----
	SEI
	
	RJMP	MAIN

;********************* 魔法の言葉おわり *********************

CROSS:
	SBRS	RWREG	,2
	RJMP	C2
	SER		RWREG
	OUT		OCR0B	,RWREG
	STS		OCR2B	,RWREG
	CLR		RWREG
	OUT		OCR0A	,RWREG
	STS		OCR2A	,RWREG
	RET
C2:
	SBRS	RWREG	,3
	RJMP	C3
	SER		RWREG
	OUT		OCR0A	,RWREG
	STS		OCR2A	,RWREG
	CLR		RWREG
	OUT		OCR0B	,RWREG
	STS		OCR2B	,RWREG
	RET
C3:
	SBRS	RWREG	,0
	RJMP	C0
	SER		RWREG
	OUT		OCR0B	,RWREG
	STS		OCR2A	,RWREG
	CLR		RWREG
	OUT		OCR0A	,RWREG
	STS		OCR2B	,RWREG
	RET
C0:
	SBRS	RWREG	,1
	RJMP	C1
	SER		RWREG
	OUT		OCR0A	,RWREG
	STS		OCR2B	,RWREG
	CLR		RWREG
	OUT		OCR0B	,RWREG
	STS		OCR2A	,RWREG
	RET
C1:
	SER		RWREG
	OUT		OCR0A	,RWREG
	OUT		OCR0B	,RWREG
	STS		OCR2A	,RWREG
	STS		OCR2B	,RWREG
	RET

RCVDATA:
	
	LDS		RWREG	,UCSR0A
	SBRS	RWREG	,RXC0
	RJMP	RCVDATA
	LDS		RDATA	,UDR0
	
	RET

MAIN:

	CLR		R2
	CLR		R3
	LDI		RWREG	,0x7f
	MOV		R4		,RWREG
	MOV		R5		,RWREG
	MOV		R6		,RWREG
	MOV		R7		,RWREG
	CLR		R8
	CLR		LHRV
	CLR		LVRV
	CLR		RHRV
	CLR		RVRV

MAIN1:
	RCALL	RCVDATA
	CPI		RDATA	,'S'
	BRBC	STA_Z	,MAIN1

	RCALL	RCVDATA
	MOV		R9		,RDATA
	RCALL	RCVDATA
	MOV		R10		,RDATA
	RCALL	RCVDATA
	MOV		R11		,RDATA
	RCALL	RCVDATA
	MOV		R12		,RDATA
	RCALL	RCVDATA
	MOV		R13		,RDATA
	RCALL	RCVDATA
	MOV		R14		,RDATA
	RCALL	RCVDATA
	MOV		R15		,RDATA

	RCALL	RCVDATA
	CPI		RDATA	,'M'
	BRBC	STA_Z	,MAIN1

	RCALL	RCVDATA
	COM		RDATA
	CP		RDATA	,R9
	BRBC	STA_Z	,MAIN1
	RCALL	RCVDATA
	COM		RDATA
	CP		RDATA	,R10
	BRBC	STA_Z	,MAIN1
	RCALL	RCVDATA
	COM		RDATA
	CP		RDATA	,R11
	BRBC	STA_Z	,MAIN1
	RCALL	RCVDATA
	COM		RDATA
	CP		RDATA	,R12
	BRBC	STA_Z	,MAIN1
	RCALL	RCVDATA
	COM		RDATA
	CP		RDATA	,R13
	BRBC	STA_Z	,MAIN1
	RCALL	RCVDATA
	COM		RDATA
	CP		RDATA	,R14
	BRBC	STA_Z	,MAIN1
	RCALL	RCVDATA
	COM		RDATA
	CP		RDATA	,R15
	BRBC	STA_Z	,MAIN1

	RCALL	RCVDATA
	CPI		RDATA	,'E'
	BRBC	STA_Z	,MAIN1

	MOV		R2		,R9
	MOV		R3		,R10
	MOV		R4		,R11
	MOV		R5		,R12
	MOV		R6		,R13
	MOV		R7		,R14
	MOV		R8		,R15

	SBRC	R8		,2
	RJMP	RANLGEND

	MOV		RWREG	,R2
	SWAP	RWREG
	RCALL	CROSS
	MOV		RWREG	,R2
	ANDI	RWREG	,0x0f
	SBRC	R3		,2
	LDI		RWREG	,0x0f
	OUT		PORTC	,RWREG

	RJMP	LANLGEND

RANLGEND:

	MOV		RWREG	,R2
	RCALL	CROSS
	MOV		RWREG	,R2
	SWAP	RWREG
	ANDI	RWREG	,0x0f
	SBRC	R3		,2
	LDI		RWREG	,0x0f
	OUT		PORTC	,RWREG

	MOV		RWREG	,R2
	SWAP	RWREG
	ANDI	RWREG	,0x0f
	SBRC	R3		,0
	LDI		RWREG	,0x0f
	OUT		PORTC	,RWREG

LANLGEND:

	MOV		RWREG	,R3
	SWAP	RWREG
	ANDI	RWREG	,0x03
	BST		R3		,6
	BLD		RWREG	,4
	BST		R3		,7
	BLD		RWREG	,5
	OUT		PORTB	,RWREG

	RJMP	MAIN1
