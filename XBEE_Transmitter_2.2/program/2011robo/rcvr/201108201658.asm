
;****************** 魔法の言葉(ATmega168p) ******************

.include "m168pdef.inc"

.def	STACK	=	R16
.def	RWREG	=	R17
.def	RDATA	=	R18
.def	LS		=	R26
.def	RS		=	R27
.def	LHRV	=	R28
.def	LVRV	=	R29
.def	RHRV	=	R30
.def	RVRV	=	R31

;.EQU ENAME	=	0
.EQU	STA_C	=	0
.EQU	STA_Z	=	1
.EQU	STA_N	=	2
.EQU	STA_V	=	3
.EQU	STA_S	=	4
.EQU	STA_H	=	5
.EQU	STA_T	=	6
.EQU	STA_I	=	7

;.dseg	data:	.BYTE	10
;.dseg
;	dSDATA:	.BYTE	7

.CSEG
	RJMP	INIT

INIT:

	CLI	
	;0:in 1:out
	LDI		RWREG	,0B00111011
	OUT		DDRB	,RWREG
	LDI		RWREG	,0B00001111
	OUT		DDRC	,RWREG
	LDI		RWREG	,0B11101000
	OUT		DDRD	,RWREG
	LDI		RWREG	,0B00000000
	OUT		PORTB	,RWREG
	LDI		RWREG	,0B00000000
	OUT		PORTC	,RWREG
	LDI		RWREG	,0B00000000
	OUT		PORTD	,RWREG
	
;******** USART設定 ********
	LDI		RWREG	,0
	STS		UBRR0H	,RWREG
	LDI 	RWREG	,64
	STS		UBRR0L	,RWREG


	LDI		RWREG	,((1<<UCSZ01)|(1<<UCSZ00))
	STS		UCSR0C	,RWREG

	LDI		RWREG	,((1<<RXEN0)|(1<<TXEN0))
	STS		UCSR0B	,RWREG

;******** A/D設定 ********
;	LDI		RWREG	,0B01100000
;	STS		ADMUX	,RWREG
;	LDI		RWREG	,((1<<ADEN)|(1<<ADIF))
;	STS		ADCSRA	,RWREG
;	LDI		RWREG	,0B00000000
;	STS		ADCSRB	,RWREG

;********タイマ設定********
	;----初期値----
	LDI		RWREG	,0x00
	OUT		TCNT0	,RWREG
	;----PWM初期値----
	LDI		RWREG	,0xff
	OUT		OCR0A	,RWREG
	OUT		OCR0B	,RWREG
	;----0x00:ノーマル 0x02:CTC(比較)----
	;----0x03:PWM
	LDI		RWREG	,0B10100011
	OUT		TCCR0A	,RWREG
	;----プリスケーラ----
	LDI		RWREG	,0x02
	OUT		TCCR0B	,RWREG

	;----初期値----
	LDI		RWREG	,0x00
	STS		TCNT2	,RWREG
	;----PWM初期値----
	LDI		RWREG	,0xff
	STS		OCR2A	,RWREG
	STS		OCR2B	,RWREG
	;----0x00:ノーマル 0x02:CTC(比較)----
	;----0x03:PWM
	LDI		RWREG	,0B10100011
	STS		TCCR2A	,RWREG
	;----プリスケーラ----
	LDI		RWREG	,0x02
	STS		TCCR2B	,RWREG

	;----全割り込み許可----
	SEI	
;RJMP	DEBUG
	RJMP	MAIN
;********************* 魔法の言葉おわり *********************

TIM0_OVF:
;	IN		STACK	,SREG
;	PUSH	RWREG
	
	SBRC	LS		,7
	RJMP	LS_INV

	SER		RWREG
	OUT		OCR0A	,RWREG
	SUB		RWREG	,LS
	SUB		RWREG	,LS
	OUT		OCR0B	,RWREG

;	POP		RWREG
;	OUT		SREG	,STACK
;	RETI
	RET

LS_INV:
	
	SER		RWREG
	OUT		OCR0B	,RWREG
	ADD		RWREG	,LS
	ADD		RWREG	,LS
	OUT		OCR0A	,RWREG

;	POP		RWREG
;	OUT		SREG	,STACK
;	RETI
	RET

TIM2_OVF:
;	IN		STACK	,SREG
;	PUSH	RWREG
	
	SBRC	RS		,7
	RJMP	RS_INV

	SER		RWREG
	STS		OCR2A	,RWREG
	SUB		RWREG	,RS
	SUB		RWREG	,RS
	STS		OCR2B	,RWREG

;	POP		RWREG
;	OUT		SREG	,STACK
;	RETI
	RET

RS_INV:
	
	SER		RWREG
	STS		OCR2B	,RWREG
	ADD		RWREG	,RS
	ADD		RWREG	,RS
	STS		OCR2A	,RWREG

;	POP		RWREG
;	OUT		SREG	,STACK

;	RETI
	RET

RCVDATA:
	
	LDS		RWREG	,UCSR0A
	SBRS	RWREG	,RXC0
	RJMP	RCVDATA
	LDS		RDATA	,UDR0
	
	RET

MAXMINR20:
	BRBS	STA_V	,MAXMINR20_1
	RET
MAXMINR20_1:
	LDI		R20		,0x7f
	BRBC	STA_S	,MAXMINR20_2
	LDI		R20		,0x80
MAXMINR20_2:
	RET

MAXMINR21:
	BRBS	STA_V	,MAXMINR21_1
	RET
MAXMINR21_1:
	LDI		R21		,0x7f
	BRBC	STA_S	,MAXMINR21_2
	LDI		R21		,0x80
MAXMINR21_2:
	RET

MAIN:

	CLR		R2
	CLR		R3
	LDI		RWREG	,0x80
	MOV		R4		,RWREG
	MOV		R5		,RWREG
	MOV		R6		,RWREG
	MOV		R7		,RWREG
	CLR		R8
	CLR		LHRV
	CLR		LVRV
	CLR		RHRV
	CLR		RVRV

MAIN1:
	RCALL	RCVDATA
	CPI		RDATA	,'S'
	BRBC	STA_Z	,MAIN1

	RCALL	RCVDATA
	MOV		R9		,RDATA
	RCALL	RCVDATA
	MOV		R10		,RDATA
	RCALL	RCVDATA
	MOV		R11		,RDATA
	RCALL	RCVDATA
	MOV		R12		,RDATA
	RCALL	RCVDATA
	MOV		R13		,RDATA
	RCALL	RCVDATA
	MOV		R14		,RDATA
	RCALL	RCVDATA
	MOV		R15		,RDATA

	RCALL	RCVDATA
	CPI		RDATA	,'M'
	BRBC	STA_Z	,MAIN1

	RCALL	RCVDATA
	COM		RDATA
	CP		RDATA	,R9
	BRBC	STA_Z	,MAIN1
	RCALL	RCVDATA
	COM		RDATA
	CP		RDATA	,R10
	BRBC	STA_Z	,MAIN1
	RCALL	RCVDATA
	COM		RDATA
	CP		RDATA	,R11
	BRBC	STA_Z	,MAIN1
	RCALL	RCVDATA
	COM		RDATA
	CP		RDATA	,R12
	BRBC	STA_Z	,MAIN1
	RCALL	RCVDATA
	COM		RDATA
	CP		RDATA	,R13
	BRBC	STA_Z	,MAIN1
	RCALL	RCVDATA
	COM		RDATA
	CP		RDATA	,R14
	BRBC	STA_Z	,MAIN1
	RCALL	RCVDATA
	COM		RDATA
	CP		RDATA	,R15
	BRBC	STA_Z	,MAIN1

	RCALL	RCVDATA
	CPI		RDATA	,'E'
	BRBC	STA_Z	,MAIN1

;DEBUG:
	MOV		R2		,R9
	MOV		R3		,R10
	MOV		R4		,R11
	MOV		R5		,R12
	MOV		R6		,R13
	MOV		R7		,R14
	MOV		R8		,R15

	SBRS	R8		,1
	RJMP	LRESET
	MOV		LHRV	,R4
	MOV		LVRV	,R5
	SUBI	LHRV	,0x80
	SUBI	LVRV	,0x80
LRESET:
	SBRS	R8		,0
	RJMP	RRESET
	MOV		RHRV	,R6
	MOV		RVRV	,R7
	SUBI	RHRV	,0x80
	SUBI	RVRV	,0x80
RRESET:

	SBRC	R8		,2
	RJMP	RANLGEND

	MOV		RWREG	,R7
	SUBI	RWREG	,0x80
	MOV		R20		,RWREG
	MOV		R21		,RWREG
	MOV		RWREG	,R6
	SUBI	RWREG	,0x80
	ADD		R20		,RWREG
	RCALL	MAXMINR20
	SUB		R21		,RWREG
	RCALL	MAXMINR21
	SUB		R20		,RVRV
	RCALL	MAXMINR20
	SUB		R21		,RVRV
	RCALL	MAXMINR21
	SUB		R20		,RHRV
	RCALL	MAXMINR20
	ADD		R21		,RHRV
	RCALL	MAXMINR21

	MOV		RWREG	,R2
	ANDI	RWREG	,0x0f
	SBRC	R3		,2
	LDI		RWREG	,0x0f
	OUT		PORTC	,RWREG

	RJMP	LANLGEND

RANLGEND:

	MOV		RWREG	,R5
	SUBI	RWREG	,0x80
	MOV		R20		,RWREG
	MOV		R21		,RWREG
	MOV		RWREG	,R4
	SUBI	RWREG	,0x80
	ADD		R20		,RWREG
	SUB		R21		,RWREG
	RCALL	MAXMINR21
	SUB		R20		,LVRV
	RCALL	MAXMINR20
	SUB		R21		,LVRV
	RCALL	MAXMINR21
	SUB		R20		,LHRV
	RCALL	MAXMINR20
	ADD		R21		,LHRV
	RCALL	MAXMINR21

	MOV		RWREG	,R2
	SWAP	RWREG
	ANDI	RWREG	,0x0f
	SBRC	R3		,0
	LDI		RWREG	,0x0f
	OUT		PORTC	,RWREG

LANLGEND:

	MOV		LS		,R20
	MOV		RS		,R21
	SBRC	LS		,7
	INC		LS
	SBRC	RS		,7
	INC		RS

	CLR		RWREG
	BST		R3		,4
	BLD		RWREG	,0
	BST		R3		,5
	BLD		RWREG	,1
	BST		R3		,6
	BLD		RWREG	,4
	BST		R3		,7
	BLD		RWREG	,5
	OUT		PORTB	,RWREG

	RCALL	TIM0_OVF
	RCALL	TIM2_OVF

	MOV		RDATA	,R4
	RCALL	SENDDATA
	MOV		RDATA	,R5
	RCALL	SENDDATA
	MOV		RDATA	,R6
	RCALL	SENDDATA
	MOV		RDATA	,R7
	RCALL	SENDDATA
	MOV		RDATA	,R20
	RCALL	SENDDATA
	MOV		RDATA	,R21
	RCALL	SENDDATA
	MOV		RDATA	,LS
	RCALL	SENDDATA
	MOV		RDATA	,RS
	RCALL	SENDDATA
;RJMP	DEBUG
	RJMP	MAIN1

SENDDATA:
	LDS		RWREG	,UCSR0A
	SBRS	RWREG	,UDRE0
	RJMP	SENDDATA
	STS		UDR0	,RDATA
	
	RET
