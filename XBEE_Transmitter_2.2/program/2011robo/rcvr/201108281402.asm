
;****************** 魔法の言葉(ATmega168p) ******************

.include "m168pdef.inc"

.def	RWREG	=	R16
.def	STACK	=	R17
.def	RDATA	=	R18
.def	LS		=	R10
.def	RS		=	R11
.def	LHMED	=	R12
.def	LVMED	=	R13
.def	RHMED	=	R14
.def	RVMED	=	R15

;.EQU ENAME	=	0
.EQU	STA_C	=	0
.EQU	STA_Z	=	1
.EQU	STA_N	=	2
.EQU	STA_V	=	3
.EQU	STA_S	=	4
.EQU	STA_H	=	5
.EQU	STA_T	=	6
.EQU	STA_I	=	7

;.dseg	data:	.BYTE	10
;.dseg
;	dSDATA:	.BYTE	7

.CSEG
	RJMP	INIT

INIT:

	CLI	
	;0:in 1:out
	LDI		RWREG	,0B00111011
	OUT		DDRB	,RWREG
	LDI		RWREG	,0B00001111
	OUT		DDRC	,RWREG
	LDI		RWREG	,0B11101000
	OUT		DDRD	,RWREG
	LDI		RWREG	,0B00000000
	OUT		PORTB	,RWREG
	LDI		RWREG	,0B00000000
	OUT		PORTC	,RWREG
	LDI		RWREG	,0B00000000
	OUT		PORTD	,RWREG
	
;******** USART設定 ********
	LDI		RWREG	,0
	STS		UBRR0H	,RWREG
	LDI 	RWREG	,64
	STS		UBRR0L	,RWREG


	LDI		RWREG	,((1<<UCSZ01)|(1<<UCSZ00))
	STS		UCSR0C	,RWREG

	LDI		RWREG	,((1<<RXEN0)|(1<<TXEN0))
	STS		UCSR0B	,RWREG

;******** A/D設定 ********
;	LDI		RWREG	,0B01100000
;	STS		ADMUX	,RWREG
;	LDI		RWREG	,((1<<ADEN)|(1<<ADIF))
;	STS		ADCSRA	,RWREG
;	LDI		RWREG	,0B00000000
;	STS		ADCSRB	,RWREG

;********タイマ設定********
	;----初期値----
	LDI		RWREG	,0x00
	OUT		TCNT0	,RWREG
	;----PWM初期値----
	LDI		RWREG	,0xff
	OUT		OCR0A	,RWREG
	OUT		OCR0B	,RWREG
	;----0x00:ノーマル 0x02:CTC(比較)----
	;----0x03:PWM
	LDI		RWREG	,0B10100011
	OUT		TCCR0A	,RWREG
	;----プリスケーラ----
	LDI		RWREG	,0x02
	OUT		TCCR0B	,RWREG

	;----初期値----
	LDI		RWREG	,0x00
	STS		TCNT2	,RWREG
	;----PWM初期値----
	LDI		RWREG	,0xff
	STS		OCR2A	,RWREG
	STS		OCR2B	,RWREG
	;----0x00:ノーマル 0x02:CTC(比較)----
	;----0x03:PWM
	LDI		RWREG	,0B10100011
	STS		TCCR2A	,RWREG
	;----プリスケーラ----
	LDI		RWREG	,0x02
	STS		TCCR2B	,RWREG

	;----全割り込み許可----
	SEI	
;RJMP	DEBUG
	RJMP	MAIN
;********************* 魔法の言葉おわり *********************

TIM0_OVF:
;	IN		STACK	,SREG
;	PUSH	RWREG
	
	SBRC	LS		,7
	RJMP	LS_INV

	SER		RWREG
	OUT		OCR0A	,RWREG
	SUB		RWREG	,LS
	SUB		RWREG	,LS
	OUT		OCR0B	,RWREG

;	POP		RWREG
;	OUT		SREG	,STACK
;	RETI
	RET

LS_INV:
	
	SER		RWREG
	OUT		OCR0B	,RWREG
	ADD		RWREG	,LS
	ADD		RWREG	,LS
	OUT		OCR0A	,RWREG

;	POP		RWREG
;	OUT		SREG	,STACK
;	RETI
	RET

TIM2_OVF:
;	IN		STACK	,SREG
;	PUSH	RWREG
	
	SBRC	RS		,7
	RJMP	RS_INV

	SER		RWREG
	STS		OCR2A	,RWREG
	SUB		RWREG	,RS
	SUB		RWREG	,RS
	STS		OCR2B	,RWREG

;	POP		RWREG
;	OUT		SREG	,STACK
;	RETI
	RET

RS_INV:
	
	SER		RWREG
	STS		OCR2B	,RWREG
	ADD		RWREG	,RS
	ADD		RWREG	,RS
	STS		OCR2A	,RWREG

;	POP		RWREG
;	OUT		SREG	,STACK

;	RETI
	RET

RCVDATA:
	
	LDS		RWREG	,UCSR0A
	SBRS	RWREG	,RXC0
	RJMP	RCVDATA
	LDS		RDATA	,UDR0
	
	RET

MAXMINZ:
	BRBS	STA_V	,MAXMINZ_1
	RET
MAXMINZ_1:
	LDI		RWREG	,0x7f
	ST		Z		,RWREG
	BRBC	STA_S	,MAXMINZ_2
	LDI		RWREG	,0x80
	ST		Z		,RWREG
MAXMINZ_2:
	RET

ABSZ:
	LD		RWREG	,Z
	SBRC	RWREG	,7
	RET
	NEG		RWREG
	ST		Z		,RWREG
	RET

MAIN:

	CLR		RWREG
	LDI		XH		,0x01
	LDI		XL		,0x00
	ST		X+		,RWREG
	ST		X+		,RWREG
	LDI		RWREG	,0x80
	ST		X+		,RWREG
	ST		X+		,RWREG
	ST		X+		,RWREG
	ST		X+		,RWREG
	CLR		RWREG
	ST		X+		,RWREG
	LDI		YH		,0x01
	LDI		ZH		,0x00
	LDI		RWREG	,0x80
	MOV		LHMED	,RWREG
	MOV		LVMED	,RWREG
	MOV		RHMED	,RWREG
	MOV		RVMED	,RWREG

MAIN1:
	RCALL	RCVDATA
	CPI		RDATA	,'S'
	BRBC	STA_Z	,MAIN1

	LDI		YL		,0x10
	RCALL	RCVDATA
	ST		Y+		,RDATA
	RCALL	RCVDATA
	ST		Y+		,RDATA
	RCALL	RCVDATA
	ST		Y+		,RDATA
	RCALL	RCVDATA
	ST		Y+		,RDATA
	RCALL	RCVDATA
	ST		Y+		,RDATA
	RCALL	RCVDATA
	ST		Y+		,RDATA
	RCALL	RCVDATA
	ST		Y+		,RDATA

	RCALL	RCVDATA
	CPI		RDATA	,'M'
	BRBC	STA_Z	,MAIN1

	LDI		YL		,0x10
	RCALL	RCVDATA
	COM		RDATA
	LD		RWREG	,Y+
	CP		RDATA	,RWREG
	BRBC	STA_Z	,MAIN1
	RCALL	RCVDATA
	COM		RDATA
	LD		RWREG	,Y+
	CP		RDATA	,RWREG
	BRBC	STA_Z	,MAIN1
	RCALL	RCVDATA
	COM		RDATA
	LD		RWREG	,Y+
	CP		RDATA	,RWREG
	BRBC	STA_Z	,MAIN1
	RCALL	RCVDATA
	COM		RDATA
	LD		RWREG	,Y+
	CP		RDATA	,RWREG
	BRBC	STA_Z	,MAIN1
	RCALL	RCVDATA
	COM		RDATA
	LD		RWREG	,Y+
	CP		RDATA	,RWREG
	BRBC	STA_Z	,MAIN1
	RCALL	RCVDATA
	COM		RDATA
	LD		RWREG	,Y+
	CP		RDATA	,RWREG
	BRBC	STA_Z	,MAIN1
	RCALL	RCVDATA
	COM		RDATA
	LD		RWREG	,Y+
	CP		RDATA	,RWREG
	BRBC	STA_Z	,MAIN1

	RCALL	RCVDATA
	CPI		RDATA	,'E'
	BRBC	STA_Z	,MAIN1

	LDI		XL		,0x00
	LDI		YL		,0x10
	LD		RWREG	,Y+
	ST		X+		,RWREG
	LD		RWREG	,Y+
	ST		X+		,RWREG
	LD		RWREG	,Y+
	ST		X+		,RWREG
	LD		RWREG	,Y+
	ST		X+		,RWREG
	LD		RWREG	,Y+
	ST		X+		,RWREG
	LD		RWREG	,Y+
	ST		X+		,RWREG
	LD		RWREG	,Y+
	ST		X+		,RWREG

	LDS		RWREG	,$0106
	SBRS	RWREG		,1
	RJMP	LRESET
	LDS		LHMED	,$0102
	LDS		LVMED	,$0103
LRESET:
	SBRS	RWREG		,0
	RJMP	RRESET
	LDS		RHMED	,$0104
	LDS		RVMED	,$0105
RRESET:

	SBRC	RWREG		,2
	RJMP	LANLGEND

	LDI		ZL		,22
	LDS		R22		,$0103
	SUB		R22		,LVMED
	RCALL	MAXMINZ
	SBRC	R22		,7
	INC		R22
	MOV		R23		,R22
	LDI		ZL		,23
	RCALL	ABSZ
	INC		R23
	MULSU	R22		,R23
	LSL		R1
	BST		R0		,7
	BLD		R1		,0
	MOV		R4		,R1

	LDI		ZL		,22
	LDS		R22		,$0102
	SUB		R22		,LVMED
	RCALL	MAXMINZ
	SBRC	R22		,7
	INC		R22
	MOV		R23		,R22
	LDI		ZL		,23
	RCALL	ABSZ
	INC		R23
	MULSU	R22		,R23
	LSL		R1
	BST		R0		,7
	BLD		R1		,0
	MOV		R5		,R1

	LDS		R20		,$0100
	SWAP	R20
	RJMP	RANLGEND
LANLGEND:

	LDI		ZL		,0x22
	LDS		R22		,$0105
	SUB		R22		,RVMED
	RCALL	MAXMINZ
	SBRC	R22		,7
	INC		R22
	MOV		R23		,R22
	LDI		ZL		,0x23
	RCALL	ABSZ
	INC		R23
	MULSU	R22		,R23
	LSL		R1
	BST		R0		,7
	BLD		R1		,0
	MOV		R4		,R1

	LDI		ZL		,22
	LDS		R22		,$0104
	SUB		R22		,RVMED
	RCALL	MAXMINZ
	SBRC	R22		,7
	INC		R22
	MOV		R23		,R22
	LDI		ZL		,23
	RCALL	ABSZ
	INC		R23
	MULSU	R22		,R23
	LSL		R1
	BST		R0		,7
	BLD		R1		,0
	MOV		R5		,R1

	LDS		R20		,$0100
RANLGEND:

	ANDI	R20		,0x0f
	LDS		RWREG	,$0101
	SBRC	RWREG	,0
	LDI		R20		,0x0f
	OUT		PORTC	,R20

	MOV		LS		,R4
	MOV		RS		,R4
	LDI		ZL		,10
	ADD		LS		,R5
	RCALL	MAXMINZ
	LDI		ZL		,11
	SUB		RS		,R5

	SBRC	LS		,7
	INC		LS
	SBRC	RS		,7
	INC		RS

	LDS		RWREG	,$0101
	CLR		R2
	BST		RWREG	,4
	BLD		R2		,0
	BST		RWREG	,5
	BLD		R2		,1
	BST		RWREG	,6
	BLD		R2		,4
	BST		RWREG	,7
	BLD		R2		,5
	OUT		PORTB	,R2

	RCALL	TIM0_OVF
	RCALL	TIM2_OVF


	LDS		RDATA	,$0102
	RCALL	SENDDATA
	LDS		RDATA	,$0103
	RCALL	SENDDATA
	LDS		RDATA	,$0104
	RCALL	SENDDATA
	LDS		RDATA	,$0105
	RCALL	SENDDATA
	MOV		RDATA	,R4
	RCALL	SENDDATA
	MOV		RDATA	,R5
	RCALL	SENDDATA
	MOV		RDATA	,LS
	RCALL	SENDDATA
	MOV		RDATA	,RS
	RCALL	SENDDATA

	RJMP	MAIN1

SENDDATA:
	LDS		RWREG	,UCSR0A
	SBRS	RWREG	,UDRE0
	RJMP	SENDDATA
	STS		UDR0	,RDATA
	
	RET
