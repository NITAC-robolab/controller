
;****************** 魔法の言葉(ATmega168p) ******************

.include "m168pdef.inc"

.def	RWREG	=	R16
.def	RWDATA	=	R17
.def	LS		=	R20
.def	RS		=	R21
.def	LHMED	=	R22
.def	LVMED	=	R23
.def	RHMED	=	R24
.def	RVMED	=	R25

;.EQU ENAME	=	0
.EQU	STA_C	=	0
.EQU	STA_Z	=	1
.EQU	STA_N	=	2
.EQU	STA_V	=	3
.EQU	STA_S	=	4
.EQU	STA_H	=	5
.EQU	STA_T	=	6
.EQU	STA_I	=	7

;.dseg	data:	.BYTE	10
;.dseg
;	dSDATA:	.BYTE	7

.CSEG
	RJMP	INIT
.ORG	0x0016
	RJMP	TIM1_OVF


INIT:


/*	LDI		R17		,0x10
	LDI		R16		,0x40
	ADD		R16		,R17
	LDI		R16		,0x6f
	ADD		R16		,R17
	LDI		R16		,0x70
	ADD		R16		,R17
	LDI		R16		,0x7f
	ADD		R16		,R17
	LDI		R16		,0xff
	SUB		R16		,R17
	LDI		R16		,0x90
	SUB		R16		,R17
	LDI		R16		,0x8f
	SUB		R16		,R17
	LDI		R16		,0x80
	SUB		R16		,R17

	LDI		R17		,0xf0
	LDI		R16		,0x40
	SUB		R16		,R17
	LDI		R16		,0x6f
	SUB		R16		,R17
	LDI		R16		,0x70
	SUB		R16		,R17
	LDI		R16		,0x7f
	SUB		R16		,R17
	LDI		R16		,0xff
	ADD		R16		,R17
	LDI		R16		,0x90
	ADD		R16		,R17
	LDI		R16		,0x8f
	ADD		R16		,R17
	LDI		R16		,0x80
	ADD		R16		,R17

	RJMP	TIM0_OVF*/


	CLI	
	;0:in 1:out
	LDI		RWREG	,0B00111011
	OUT		DDRB	,RWREG
	LDI		RWREG	,0B00001111
	OUT		DDRC	,RWREG
	LDI		RWREG	,0B11111100
	OUT		DDRD	,RWREG
	LDI		RWREG	,0B00000000
	OUT		PORTB	,RWREG
	LDI		RWREG	,0B00000000
	OUT		PORTC	,RWREG
	LDI		RWREG	,0B00000000
	OUT		PORTD	,RWREG
	
;******** USART設定 ********
	LDI		RWREG	,0
	STS		UBRR0H	,RWREG
	LDI 	RWREG	,64
	STS		UBRR0L	,RWREG


	LDI		RWREG	,((1<<UCSZ01)|(1<<UCSZ00))
	STS		UCSR0C	,RWREG

	LDI		RWREG	,((1<<RXEN0)|(1<<TXEN0))
	STS		UCSR0B	,RWREG

;******** A/D設定 ********
;	LDI		RWREG	,0B01100000
;	STS		ADMUX	,RWREG
;	LDI		RWREG	,((1<<ADEN)|(1<<ADIF))
;	STS		ADCSRA	,RWREG
;	LDI		RWREG	,0B00000000
;	STS		ADCSRB	,RWREG

;********タイマ設定********
	;----初期値----
	LDI		RWREG	,0x00
	OUT		TCNT0	,RWREG
	;----PWM初期値----
	LDI		RWREG	,0xff
	OUT		OCR0A	,RWREG
	OUT		OCR0B	,RWREG
	;----0x00:ノーマル 0x02:CTC(比較)----
	;----0x03:PWM
	LDI		RWREG	,0B10100011
	OUT		TCCR0A	,RWREG
	;----プリスケーラ----
	LDI		RWREG	,0x02
	OUT		TCCR0B	,RWREG

	;----初期値----
	LDI		RWREG	,0x00
	STS		TCNT2	,RWREG
	;----PWM初期値----
	LDI		RWREG	,0xff
	STS		OCR2A	,RWREG
	STS		OCR2B	,RWREG
	;----0x00:ノーマル 0x02:CTC(比較)----
	;----0x03:PWM
	LDI		RWREG	,0B10100011
	STS		TCCR2A	,RWREG
	;----プリスケーラ----
	LDI		RWREG	,0x02
	STS		TCCR2B	,RWREG

	;----初期値----
	LDI		RWREG	,0x00
	STS		TCNT1H	,RWREG
	STS		TCNT1L	,RWREG
	;----PWM初期値----
	LDI		RWREG	,0x7a
	STS		OCR1AH	,RWREG
	LDI		RWREG	,0x12
	STS		OCR1AL	,RWREG
	;----0x00:ノーマル
	LDI		RWREG	,0B00000000
	STS		TCCR1A	,RWREG
	;----割り込み--
	LDI		RWREG	,0B00000010
	STS		TIMSK1	,RWREG
	;----プリスケーラ----
	LDI		RWREG	,0B00001100
	STS		TCCR1B	,RWREG
	
	;----全割り込み許可----
	SEI	

	RJMP	MAIN
;********************* 魔法の言葉おわり *********************

TIM0_OVF:

	LDS		RWREG	,$0101
	SBRC	RWREG	,4
	SBR		RWREG	,(1<<5)
	SBRC	RWREG	,6
	SBR		RWREG	,(1<<5)
	SBRS	RWREG	,5
	RJMP	LS_POS
	CLR		RWREG
	OUT		OCR0A	,RWREG
	OUT		OCR0B	,RWREG
	RET

LS_POS:
	SBRC	LS		,7
	RJMP	LS_INV

	SER		RWREG
	OUT		OCR0A	,RWREG
	SUB		RWREG	,LS
	SUB		RWREG	,LS
	DEC		RWREG
	OUT		OCR0B	,RWREG

	RET

LS_INV:
	
	SER		RWREG
	OUT		OCR0B	,RWREG
	ADD		RWREG	,LS
	ADD		RWREG	,LS
	INC		RWREG
	OUT		OCR0A	,RWREG

	RET

TIM2_OVF:

	LDS		RWREG	,$0101
	SBRC	RWREG	,4
	SBR		RWREG	,(1<<7)
	SBRC	RWREG	,6
	SBR		RWREG	,(1<<7)
	SBRS	RWREG	,7
	RJMP	RS_POS
	CLR		RWREG
	STS		OCR2A	,RWREG
	STS		OCR2B	,RWREG
	RET

RS_POS:
	SBRC	RS		,7
	RJMP	RS_INV

	SER		RWREG
	STS		OCR2A	,RWREG
	SUB		RWREG	,RS
	SUB		RWREG	,RS
	DEC		RWREG
	STS		OCR2B	,RWREG

	RET

RS_INV:
	
	SER		RWREG
	STS		OCR2B	,RWREG
	ADD		RWREG	,RS
	ADD		RWREG	,RS
	INC		RWREG
	STS		OCR2A	,RWREG

	RET

TIM1_OVF:
	PUSH	RWREG
	IN		RWREG	,SREG
	PUSH	RWREG

	SER		RWREG
	OUT		OCR0A	,RWREG
	OUT		OCR0B	,RWREG
	STS		OCR2A	,RWREG
	STS		OCR2B	,RWREG
	CLR		RWREG
	OUT		PORTC	,RWREG

	CBI		PORTD	,2
	SBI		PORTD	,4

	POP		RWREG
	OUT		SREG	,RWREG
	POP		RWREG
	RETI

RCVDATA:
	
	LDS		RWREG	,UCSR0A
	SBRS	RWREG	,RXC0
	RJMP	RCVDATA
	LDS		RWDATA	,UDR0
	
	RET

SENDDATA:
	LDS		RWREG	,UCSR0A
	SBRS	RWREG	,UDRE0
	RJMP	SENDDATA
	STS		UDR0	,RWDATA
	
	RET

EEPROM_W:
	PUSH	RWREG
EEPROM_W1:
	SBIC	EECR	,EEPE
	RJMP	EEPROM_W1

	LDI		RWREG	,(0<<EEPM1)|(0<<EEPM0)
	OUT		EECR	,RWREG
	OUT		EEARH	,ZH
	OUT		EEARL	,ZL
	OUT		EEDR	,RWDATA
	SBI		EECR	,EEMPE
	SBI		EECR	,EEPE

	POP		RWREG
	RET

EEPROM_R:
	SBIC	EECR	,EEPE
	RJMP	EEPROM_R

;	OUT		EEARH	,ZH
	OUT		EEARL	,ZL
	SBI		EECR	,EERE
	IN		RWDATA	,EEDR
	RET

MAIN:
	CLR		RWREG
	LDI		XH		,0x01
	LDI		XL		,0x00
	ST		X+		,RWREG
	ST		X+		,RWREG
	LDI		RWREG	,0x80
	ST		X+		,RWREG
	ST		X+		,RWREG
	ST		X+		,RWREG
	ST		X+		,RWREG
	CLR		RWREG
	ST		X+		,RWREG
	LDI		YH		,0x01
	LDI		ZH		,0x00

	CLI
	LDI		ZL		,0x00
	RCALL	EEPROM_R
	MOV		LHMED	,RWDATA
	LDI		ZL		,0x01
	RCALL	EEPROM_R
	MOV		LVMED	,RWDATA
	LDI		ZL		,0x02
	RCALL	EEPROM_R
	MOV		RHMED	,RWDATA
	LDI		ZL		,0x03
	RCALL	EEPROM_R
	MOV		RVMED	,RWDATA
	SEI

MAIN1:
	RCALL	RCVDATA
	CPI		RWDATA	,'S'
	BRBC	STA_Z	,MAIN1

	LDI		YL		,0x10
	RCALL	RCVDATA
	ST		Y+		,RWDATA
	RCALL	RCVDATA
	ST		Y+		,RWDATA
	RCALL	RCVDATA
	ST		Y+		,RWDATA
	RCALL	RCVDATA
	ST		Y+		,RWDATA
	RCALL	RCVDATA
	ST		Y+		,RWDATA
	RCALL	RCVDATA
	ST		Y+		,RWDATA
	RCALL	RCVDATA
	ST		Y+		,RWDATA

	RCALL	RCVDATA
	CPI		RWDATA	,'M'
	BRBC	STA_Z	,MAIN1

	LDI		YL		,0x10
	RCALL	RCVDATA
	COM		RWDATA
	LD		RWREG	,Y+
	CP		RWDATA	,RWREG
	BRBC	STA_Z	,MAIN1
	RCALL	RCVDATA
	COM		RWDATA
	LD		RWREG	,Y+
	CP		RWDATA	,RWREG
	BRBC	STA_Z	,MAIN1
	RCALL	RCVDATA
	COM		RWDATA
	LD		RWREG	,Y+
	CP		RWDATA	,RWREG
	BRBC	STA_Z	,MAIN1
	RCALL	RCVDATA
	COM		RWDATA
	LD		RWREG	,Y+
	CP		RWDATA	,RWREG
	BRBC	STA_Z	,MAIN1
	RCALL	RCVDATA
	COM		RWDATA
	LD		RWREG	,Y+
	CP		RWDATA	,RWREG
	BRBC	STA_Z	,MAIN1
	RCALL	RCVDATA
	COM		RWDATA
	LD		RWREG	,Y+
	CP		RWDATA	,RWREG
	BRBC	STA_Z	,MAIN1
	RCALL	RCVDATA
	COM		RWDATA
	LD		RWREG	,Y+
	CP		RWDATA	,RWREG
	BRBC	STA_Z	,MAIN1

	RCALL	RCVDATA
	CPI		RWDATA	,'E'
	BRBC	STA_Z	,MAIN1

	LDI		XL		,0x00
	LDI		YL		,0x10
	LD		RWREG	,Y+
	ST		X+		,RWREG
	LD		RWREG	,Y+
	ST		X+		,RWREG
	LD		RWREG	,Y+
	ST		X+		,RWREG
	LD		RWREG	,Y+
	ST		X+		,RWREG
	LD		RWREG	,Y+
	ST		X+		,RWREG
	LD		RWREG	,Y+
	ST		X+		,RWREG
	LD		RWREG	,Y+
	ST		X+		,RWREG

	LDS		RWREG	,$0106
	SBRS	RWREG	,0
	RJMP	RRESET

	SBRS	RWREG	,3
	RJMP	LRESET
	LDS		LHMED	,$0102
	SUBI	LHMED	,0x80
	LDS		LVMED	,$0103
	SUBI	LVMED	,0x80

	CLI
	LDI		ZL		,0x00
	MOV		RWDATA	,LHMED
	RCALL	EEPROM_W
	LDI		ZL		,0x01
	MOV		RWDATA	,LVMED
	RCALL	EEPROM_W
	SEI

LRESET:
	SBRS	RWREG		,2
	RJMP	RRESET
	LDS		RHMED	,$0104
	SUBI	RHMED	,0x80
	LDS		RVMED	,$0105
	SUBI	RVMED	,0x80

	CLI
	LDI		ZL		,0x02
	MOV		RWDATA	,RHMED
	RCALL	EEPROM_W
	LDI		ZL		,0x03
	MOV		RWDATA	,RVMED
	RCALL	EEPROM_W
	SEI

RRESET:

	LDS		LS		,$0103
	SUBI	LS		,0x80
	LDS		RS		,$0105
	SUBI	RS		,0x80
	LDI		ZL		,20
	SUB		LS		,LVMED
	RCALL	MAXMINZ
	LDI		ZL		,21
	SUB		RS		,RVMED
	RCALL	MAXMINZ

	LDI		ZL		,16
	MOV		RWREG	,LS
	RCALL	ABSZ
	CPI		RWREG	,0x28
	BRBS	STA_C	,LS_N

	LDI		ZL		,20
	BST		LS		,7
	BRBC	STA_T	,LS_P
	SUBI	LS		,0x18
	RCALL	MAXMINZ
	ANDI	LS		,0xf0
	RJMP	LS_N
LS_P:
	SUBI	LS		,0xe8
	RCALL	MAXMINZ
	ORI		LS		,0x0f
LS_N:

	LDI		ZL		,16
	MOV		RWREG	,RS
	RCALL	ABSZ
	CPI		RWREG	,0x28
	BRBS	STA_C	,RS_N

	LDI		ZL		,21
	BST		RS		,7
	BRBC	STA_T	,RS_P
	SUBI	RS		,0x18
	RCALL	MAXMINZ
	ANDI	RS		,0xf0
	RJMP	RS_N
RS_P:
	SUBI	RS		,0xe8
	RCALL	MAXMINZ
	ORI		RS		,0x0f
RS_N:
	
	LDS		R19		,$0100
	SBRS	R19		,1
	RJMP	CROSS1
	LDI		LS		,0x7f
	LDI		RS		,0x80
CROSS1:
	SBRS	R19		,0
	RJMP	CROSS0
	LDI		LS		,0x80
	LDI		RS		,0x7f
CROSS0:
	SBRS	R19		,3
	RJMP	CROSS3
	LDI		LS		,0x80
	LDI		RS		,0x80
CROSS3:
	SBRS	R19		,2
	RJMP	CROSS2
	LDI		LS		,0x7f
	LDI		RS		,0x7f
CROSS2:

	SWAP	R19
	ANDI	R19		,0x0f
	LDS		RWREG	,$0101
	SBRC	RWREG	,0
	LDI		R19		,0x0f
	SBRC	RWREG	,2
	LDI		R19		,0x0f
	OUT		PORTC	,R19

	RCALL	TIM0_OVF
	RCALL	TIM2_OVF

	LDS		RWREG	,$0106
	SBRS	RWREG	,3
	RJMP	SENDDEBUG

	LDI		RWDATA	,'\n'
	RCALL	SENDDATA
	LDS		RWDATA	,$0103
	RCALL	SENDDATA
	LDS		RWDATA	,$0105
	RCALL	SENDDATA
	MOV		RWDATA	,LVMED
	RCALL	SENDDATA
	MOV		RWDATA	,RVMED
	RCALL	SENDDATA
	MOV		RWDATA	,LS
	RCALL	SENDDATA
	MOV		RWDATA	,RS
	RCALL	SENDDATA
	IN		RWDATA	,OCR0A
	RCALL	SENDDATA
	IN		RWDATA	,OCR0B
	RCALL	SENDDATA
	LDS		RWDATA	,OCR2A
	RCALL	SENDDATA
	LDS		RWDATA	,OCR2B
	RCALL	SENDDATA
	LDI		RWDATA	,0x00
	RCALL	SENDDATA
	
SENDDEBUG:

	LDI		RWREG	,0x00
	STS		TCNT1H	,RWREG
	STS		TCNT1L	,RWREG

	SBI		PORTD	,2
	CBI		PORTD	,4

	RJMP	MAIN1

MAXMINZ:
	BRBS	STA_V	,MAXMINZ_1
	RET
MAXMINZ_1:
	PUSH	RWREG
	LDI		RWREG	,0x7f
	ST		Z		,RWREG
	BRBC	STA_S	,MAXMINZ_2
	LDI		RWREG	,0x80
	ST		Z		,RWREG
MAXMINZ_2:
	POP		RWREG
	RET

ABSZ:
	
	PUSH	RWREG
	LD		RWREG	,Z
	SBRS	RWREG	,7
	RJMP	ABSZ_1
	NEG		RWREG
	ST		Z		,RWREG
ABSZ_1:
	POP		RWREG
	RETI